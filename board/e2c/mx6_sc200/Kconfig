## board/e2c/mx6_sc200/Kconfig
```kconfig
if TARGET_MX6_SC200

config SYS_BOARD
	default "mx6_sc200"

config SYS_VENDOR
	default "e2c"

config SYS_CONFIG_NAME
	default "mx6_sc200"

endif
```

## board/e2c/mx6ul_playgo/Kconfig
```kconfig
if TARGET_MX6UL_PLAYGO

config SYS_BOARD
	default "mx6ul_playgo"

config SYS_VENDOR
	default "e2c"

config SYS_CONFIG_NAME
	default "mx6ul_playgo"

endif
```

## board/e2c/mx6ul_sc100/Kconfig
```kconfig
if TARGET_MX6UL_SC100

config SYS_BOARD
	default "mx6ul_sc100"

config SYS_VENDOR"
	default "e2c"

config SYS_CONFIG_NAME
	default "mx6ul_sc100"

endif
```

## board/e2c/mx6ul_sc100_02/Kconfig
```kconfig
if TARGET_MX6UL_SC100_02

config SYS_BOARD
	default "mx6ul_sc100_02"

config SYS_VENDOR
	default "e2c"

config SYS_CONFIG_NAME
	default "mx6ul_sc100_02"

endif
```
